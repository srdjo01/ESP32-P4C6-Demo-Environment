## firmware/sdkconfig.defaults
```kconfig
# ── Chip ────────────────────────────────────────────────────────────────────
CONFIG_IDF_TARGET="esp32p4"
CONFIG_ESP32P4_REV_MIN_1_3=y

# ── Flash / partitions (display + LVGL push the app over the default 1 MB) ───
CONFIG_ESPTOOLPY_FLASHSIZE_4MB=y
CONFIG_PARTITION_TABLE_CUSTOM=y
CONFIG_PARTITION_TABLE_CUSTOM_FILENAME="partitions.csv"

# ── PSRAM ───────────────────────────────────────────────────────────────────
CONFIG_SPIRAM=y
CONFIG_SPIRAM_MODE_OCT=y
CONFIG_SPIRAM_SPEED_200M=y

# ── TinyUSB (USB 2.0 PHY — NOT USJ) ─────────────────────────────────────────
CONFIG_TINYUSB_CDC_ENABLED=y
CONFIG_TINYUSB_CDC_RX_BUFSIZE=512
# TX buffer holds a full response in one shot (PROTO_RESP_MAX); proto_send also
# chunks anything larger. 512 truncated big wifi_scan responses.
CONFIG_TINYUSB_CDC_TX_BUFSIZE=1024
# Protocol commands are dispatched in the TinyUSB task; the Wi-Fi path (C6 proxy
# + cJSON) needs more than the 4 KB default.
CONFIG_TINYUSB_TASK_STACK_SIZE=8192
CONFIG_TINYUSB_DESC_MANUFACTURER_STRING="ESP32-P4C6 Demo"
CONFIG_TINYUSB_DESC_PRODUCT_STRING="ESP32-P4C6 Demo Board"
CONFIG_TINYUSB_DESC_SERIAL_STRING="P4C6-001"

# ── Logging ─────────────────────────────────────────────────────────────────
CONFIG_LOG_DEFAULT_LEVEL_INFO=y

# ── FreeRTOS ─────────────────────────────────────────────────────────────────
CONFIG_FREERTOS_HZ=1000

# ── SDMMC (eMMC) ─────────────────────────────────────────────────────────────
CONFIG_SDMMC_USE_GPIO_MATRIX=y

# ── Wi-Fi (via ESP-Hosted / ESP32-C6 SDIO) ──────────────────────────────────
# Uncomment and configure when ESP-Hosted is wired to the C6 coprocessor.
# CONFIG_ESP_HOSTED_ENABLED=y
```

## firmware_c6/sdkconfig.defaults
```kconfig
# ── Target ───────────────────────────────────────────────────────────────────
CONFIG_IDF_TARGET="esp32c6"

# ── Console / logging ────────────────────────────────────────────────────────
# Keep the default UART console (UART0 → CH340 → COM4). Logs share this UART
# with the JSON protocol; the host filters out non-JSON lines. Lower the log
# level to reduce noise on the wire.
CONFIG_LOG_DEFAULT_LEVEL_WARN=y

# ── Wi-Fi ────────────────────────────────────────────────────────────────────
CONFIG_ESP_WIFI_ENABLED=y

# ── Bluetooth (NimBLE host) ──────────────────────────────────────────────────
# Keep all NimBLE roles at their defaults — disabling roles trips a known
# compile bug in the IDF 5.4.1 NimBLE sources (missing static functions).
CONFIG_BT_ENABLED=y
CONFIG_BT_NIMBLE_ENABLED=y

# ── Wi-Fi / BLE coexistence (both radios share the 2.4 GHz front-end) ─────────
CONFIG_ESP_COEX_SW_COEXIST_ENABLE=y

# ── Flash / partitions (Wi-Fi + BLE binary is ~1.2 MB) ───────────────────────
CONFIG_ESPTOOLPY_FLASHSIZE_4MB=y
CONFIG_PARTITION_TABLE_CUSTOM=y
CONFIG_PARTITION_TABLE_CUSTOM_FILENAME="partitions.csv"

# ── FreeRTOS ─────────────────────────────────────────────────────────────────
CONFIG_FREERTOS_HZ=1000
```
